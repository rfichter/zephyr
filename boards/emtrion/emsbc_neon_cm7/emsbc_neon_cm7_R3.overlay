/*
 * Copyright (c) 2025 emtrion GmbH
 *
 * SPDX-License-Identifier: Apache-2.0
 */

/ {
	aliases {
		eeprom-0 = &eeprom0;
	};
};

&i2c1 {
	eeprom0: eeprom@50 {
		/* 24AA02E48T */
		compatible = "st,m24xxx", "atmel,at24";
		reg = <0x50>;
		size = <256>;
		pagesize = <16>;
		address-width = <8>;
		timeout = <5>;
		status = "okay";
	};
};
