## boards/emtrion/emsbc_neon_cm7/emsbc_neon_cm7_R3_defconfig
```kconfig
# Copyright (c) 2025 emtrion GmbH
# SPDX-License-Identifier: Apache-2.0

CONFIG_EEPROM=y
CONFIG_EEPROM_INIT_PRIORITY=75
CONFIG_EEPROM_AT2X_INIT_PRIORITY=75
```
